/*
 * Adds ZMK Studio support to the Redox shield, which lacks a physical
 * layout in ZMK v0.2 (added upstream only after v0.3, Sept 2025).
 * redox-layouts.dtsi is copied verbatim from upstream main.
 */

#include "redox-layouts.dtsi"

&redox_physical_layout {
    transform = <&default_transform>;
};

/ {
    chosen {
        /* The legacy chosen matrix transform must be removed, otherwise
         * ZMK ignores physical layouts and the Studio build assert fails. */
        /delete-property/ zmk,matrix-transform;
        zmk,physical-layout = &redox_physical_layout;
    };
};
